AUTOSAR XML (schema 4-0-3)
standard types defined: uint8, uint16, uint32
package /Rte_InternalDataTypes
  base type BaseType_uint8: category=FIXED_LENGTH, base-type-size=8, base-type-encoding=NONE
  base type BaseType_uint16: category=FIXED_LENGTH, base-type-size=16, base-type-encoding=NONE
  base type BaseType_uint32: category=FIXED_LENGTH, base-type-size=32, base-type-encoding=NONE
  impl type Com_SignalIdType: category=VALUE, base-type=BaseType_uint16
